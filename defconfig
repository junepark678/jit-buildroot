## defconfig
```kconfig
BR2_aarch64=y
BR2_cortex_a76=y
BR2_TOOLCHAIN_BUILDROOT_VENDOR="pythonplayer123"
BR2_TOOLCHAIN_BUILDROOT_MUSL=y
BR2_KERNEL_HEADERS_6_6=y
BR2_BINUTILS_VERSION_2_43_X=y
BR2_GCC_VERSION_12_X=y
BR2_EXTRA_GCC_CONFIG_OPTIONS="--enable-libgomp"
BR2_TOOLCHAIN_BUILDROOT_CXX=y
BR2_GCC_ENABLE_OPENMP=y
BR2_GCC_ENABLE_GRAPHITE=y
BR2_TARGET_OPTIMIZATION="-mtune=cortex-a76 -funroll-loops -finline-functions -ftree-vectorize -fno-exceptions -floop-nest-optimize -floop-parallelize-all -ftree-loop-distribution -fopenmp-simd -floop-block -ftree-vectorize -ftree-vrp -fdelete-null-pointer-checks -fivopts -ftree-loop-ivcanon -fgraphite-identity "
BR2_CCACHE=y
BR2_CCACHE_DIR="/mnt/datadisk4/buildroot/buildroot-ccache"
BR2_OPTIMIZE_FAST=y
BR2_ENABLE_LTO=y
BR2_SHARED_STATIC_LIBS=y
BR2_SSP_NONE=y
BR2_TARGET_GENERIC_HOSTNAME="JITVM"
BR2_TARGET_GENERIC_ISSUE="Welcome to JIToBR. Run `./activate.sh` to get started. :) made with <3 by pythonplayer123 under the the GNU AGPLv3"
BR2_ROOTFS_MERGED_USR=y
BR2_TARGET_GENERIC_ROOT_PASSWD="password"
BR2_TARGET_GENERIC_GETTY_OPTIONS="--autologin root --noclear"
BR2_SYSTEM_DHCP="eth0"
BR2_ROOTFS_OVERLAY="board/sidestore/jitserver/rootfs-overlay"
BR2_LINUX_KERNEL=y
BR2_LINUX_KERNEL_USE_ARCH_DEFAULT_CONFIG=y
BR2_LINUX_KERNEL_CUSTOM_LOGO_PATH="bootlogo_224.ppm"
BR2_LINUX_KERNEL_ZSTD=y
BR2_PACKAGE_USBMUXD=y
BR2_PACKAGE_LIBIMOBILEDEVICE_GLUE=y
BR2_PACKAGE_PYTHON3=y
BR2_PACKAGE_PYTHON_CLICK=y
BR2_PACKAGE_PYTHON_ZEROCONF=y
BR2_PACKAGE_IPROUTE2=y
BR2_PACKAGE_IPTABLES=y
BR2_PACKAGE_TAILSCALE=y
BR2_PACKAGE_UTIL_LINUX=y
BR2_PACKAGE_UTIL_LINUX_BINARIES=y
BR2_TARGET_ROOTFS_EXT2=y
BR2_TARGET_ROOTFS_EXT2_LABEL="pythonplayer123"
BR2_TARGET_ROOTFS_EXT2_SIZE="700M"
BR2_TARGET_ROOTFS_EXT2_ZSTD=y
BR2_TARGET_GRUB2=y
BR2_TARGET_GRUB2_BUILTIN_CONFIG_EFI="boot/grub2/grub.cfg"
```

## package/libimobiledevice-glue/Config.in
```kconfig
config BR2_PACKAGE_LIBIMOBILEDEVICE_GLUE
	bool "libimobiledevice-glue"
        select BR2_PACKAGE_LIBPLIST
	
```

## package/libusbmuxd/Config.in
```kconfig
config BR2_PACKAGE_LIBUSBMUXD
	bool "libusbmuxd"
	depends on BR2_PACKAGE_LIBIMOBILEDEVICE_GLUE
        select BR2_PACKAGE_LIBPLIST
```

## package/usbmuxd/Config.in
```kconfig
config BR2_PACKAGE_USBMUXD
	bool "usbmuxd"
	select BR2_PACKAGE_LIBUSBMUXD
	select BR2_PACKAGE_LIBPLIST
	select BR2_PACKAGE_LIBUSB
```
